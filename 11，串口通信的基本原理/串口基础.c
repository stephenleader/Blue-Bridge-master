#include "reg52.h"

sfr AUXR = 0x8e;

unsigned char urdat;

void Send(unsigned char dat)
{
	SBUF = dat;
	while(!TI);
	TI = 0;
}
void UartInit(void)		//9600bps@11.0592MHz
{
	PCON &= 0x7F;		//??????
	SCON = 0x50;		//8???,?????
	AUXR |= 0x40;		//???1???Fosc,?1T
	AUXR &= 0xFE;		//??1?????1???????
	TMOD &= 0x0F;		//?????1???
	TMOD |= 0x20;		//?????1?8???????
	TL1 = 0xDC;		//??????
	TH1 = 0xDC;		//????????
	ET1 = 0;		//?????1??
	TR1 = 1;
	
	ES = 1;
	EA = 1;
}
void ServiceUart() interrupt 4
{
	if(RI == 1)
	{
		RI = 0;
		urdat = SBUF;
		Send(urdat);
	}
}

void main()
{
	UartInit();
	Send(0x5a);
	Send(0xa5);
	while(1);
}